## arch/arm/configs/msm8226-sec_s3ve3g_eur_defconfig
```kconfig
#RTCC
CONFIG_SWAP=y
CONFIG_ZRAM=y
CONFIG_ZRAM_DEBUG=y
CONFIG_ZRAM_FOR_ANDROID=y

#variant defconfig
CONFIG_MACH_S3VE3G_EUR=y
CONFIG_SEC_S3VE_PROJECT=y

#Power Management
CONFIG_SEC_PM=n

#LCD
CONFIG_FB_MSM_MIPI_S6E8AA0A_720P_PT_PANEL=y
# CONFIG_ESD_ERR_FG_RECOVERY is not set
CONFIG_FB_MSM_MDSS=y
CONFIG_FB_MSM_MDSS_WRITEBACK=y
CONFIG_BACKLIGHT_LCD_SUPPORT=y
# CONFIG_MDNIE_LITE_TUNING is not set
CONFIG_LCD_CLASS_DEVICE=y
CONFIG_BACKLIGHT_CLASS_DEVICE=y
#CONFIG_BACKLIGHT_GENERIC is not set

#SvcLED
CONFIG_LEDS_AN30259A=y

#VIBRATOR

#TSP
#CONFIG_TOUCHSCREEN_MMS252 is not set
#CONFIG_TOUCHSCREEN_BCMTCH15XXX is not set
#CONFIG_KEYBOARD_CYPRESS_TOUCH is not set
CONFIG_KEYBOARD_CYPRESS_TOUCH_S3=y
CONFIG_TOUCHSCREEN_MMS144=y

#SENSOR
CONFIG_INPUT_POLLDEV=y
CONFIG_INPUT=y
CONFIG_INPUT_GPIO=y
CONFIG_SENSORS_HALL=y

#CAMERA

#USB
CONFIG_USB_ANDROID_SAMSUNG_COMPOSITE=y
CONFIG_USB_ANDROID_SAMSUNG_MTP=y
CONFIG_USB_DUN_SUPPORT=y
CONFIG_USB_ANDROID_SAMSUNG_SIDESYNC=y

#USB Host
CONFIG_USB_HOST_NOTIFY=y
CONFIG_USB_STORAGE_DETECT=y
CONFIG_USB_NET_SMSC75XX=y
CONFIG_USB_NET_SMSC95XX=y

#MUIC
#CONFIG_MFD_MAX77693=y
#CONFIG_USB_SWITCH_MAX77693=y
#CONFIG_REGULATOR_MAX77693=y
#CONFIG_DI_MUIC=n
#CONFIG_MUIC_INIT_DETECT_DELAY=3000
#CONFIG_MUIC_USB_DETECT_DELAY=17000
#CONFIG_USB_SWITCH_TSU6721=y
CONFIG_SM5502_MUIC=y

# IRDA support
# CONFIG_IR_REMOCON_MC96 is not set

#Battery charging & BMS
CONFIG_BATTERY_SAMSUNG=y
CONFIG_CHARGER_SMB358=y
CONFIG_BATTERY_BCL=y
CONFIG_QPNP_BMS=y

#Sec Thermistor
CONFIG_SEC_THERMISTOR=y

# Earjack
CONFIG_SAMSUNG_JACK=y

# CODEC
#CONFIG_SND_SOC_MAX98504 is not set

# GPIO DVS
#CONFIG_SEC_GPIO_DVS is not set
# DHA Solution
#CONFIG_SEC_DHA_SOL_MAL is not set

# QCOM DEBUG
CONFIG_MSM_RTB=y
CONFIG_MSM_RTB_SEPARATE_CPUS=y 
```

## arch/arm/configs/msm8926-sec_afyonltetmo_defconfig
```kconfig
#variant defconfig
CONFIG_MACH_AFYONLTE_TMO=y
CONFIG_SEC_AFYON_PROJECT=y
CONFIG_SEC_AFYONLTE_COMMON=y

#Power Management
CONFIG_SEC_PM=n

CONFIG_FB_MSM_MDSS_CPT_QHD_PANEL=y
CONFIG_FB_MSM8x26_MDSS_CHECK_LCD_CONNECTION=y
#CONFIG_ESD_ERR_FG_RECOVERY=y
CONFIG_FB_MSM_MDSS=y
CONFIG_FB_MSM_MDSS_WRITEBACK=y
CONFIG_BACKLIGHT_LCD_SUPPORT=y
#CONFIG_MDNIE_TFT_MSM8X26=y
CONFIG_LCD_CLASS_DEVICE=y
CONFIG_BACKLIGHT_CLASS_DEVICE=y
# CONFIG_BACKLIGHT_GENERIC is not set
#CONFIG_TC358764_I2C_CONTROL=y

#VIBRATOR
#CONFIG_QPNP_VIBRATOR is not set
CONFIG_MSM_VIBRATOR=y

#TKEY LEDS
CONFIG_LEDS_GPIO=y

#TSP
#CONFIG_TOUCHSCREEN_ATMEL_MXT1188S=y
#CONFIG_TOUCHSCREEN_MMS252=y
#CONFIG_TOUCHSCREEN_BCMTCH15XXX is not set
#CONFIG_KEYBOARD_CYPRESS_TOUCH is not set
CONFIG_TOUCHSCREEN_CYTTSP4=y
#KEYS
CONFIG_KEYBOARD_GPIO=y

#SENSOR
CONFIG_SENSORS=y
CONFIG_SENSORS_BMA255=y
CONFIG_SENSORS_HSCDTD008A=y
CONFIG_INPUT_POLLDEV=y
CONFIG_SENSORS_GP2A002=y
CONFIG_SENSORS_POWERCONTROL=y
CONFIG_SENSORS_GP2A_VDDCONTROL=y
#CONFIG_SENSORS_K3DH=y
#CONFIG_SENSOR_K3DH_INPUTDEV=y
#CONFIG_SENSORS_SX9500=y
#CONFIG_SENSORS_SX9500_INIT_TOUCH_THRESHOLD=3000
#CONFIG_SENSORS_SX9500_NORMAL_TOUCH_THRESHOLD=17

#CONFIG_PROXIMITY_SENSOR=y
#CONFIG_OPTICAL_TAOS_TMD2672X=y
#CONFIG_SENSORS_ASP01=y

CONFIG_INPUT=y
CONFIG_INPUT_GPIO=y
#CONFIG_SENSORS_HALL=y

#CAMERA
#CONFIG_MSM_CPP=y
#CONFIG_S5K3H5XA=y
#CONFIG_S5K4H5YB=y
#CONFIG_S5K6A3YX=y
#CONFIG_ISX012=y
#CONFIG_SR352=y
#CONFIG_SR130PC20=y

#USB
CONFIG_USB_ANDROID_SAMSUNG_COMPOSITE=y
CONFIG_USB_ANDROID_SAMSUNG_MTP=y
CONFIG_USB_DUN_SUPPORT=y
CONFIG_USB_HOST_NOTIFY=y
CONFIG_USB_STORAGE_DETECT=y
CONFIG_USB_ANDROID_SAMSUNG_SIDESYNC=y

#MUIC
#CONFIG_MFD_MAX77693=y
#CONFIG_USB_SWITCH_MAX77693=y
#CONFIG_REGULATOR_MAX77693=y
#CONFIG_DI_MUIC=n
#CONFIG_MUIC_INIT_DETECT_DELAY=3000
#CONFIG_MUIC_USB_DETECT_DELAY=17000
CONFIG_USB_SWITCH_TSU6721=y


# IRDA support
#CONFIG_IR_REMOCON_MC96=y

#Battery charging & BMS
CONFIG_BATTERY_SAMSUNG=y
CONFIG_CHARGER_SMB358=y
CONFIG_BATTERY_BCL=y
CONFIG_QPNP_BMS=y

#BT
no need

#Wifi
no need

# Earjack
CONFIG_SAMSUNG_JACK=y
```
